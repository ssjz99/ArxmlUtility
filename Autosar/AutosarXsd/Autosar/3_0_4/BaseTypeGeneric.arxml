AUTOSAR XML (schema 3.0.4)
standard types defined: uint8, uint16, uint32, float32, float64, boolean
package /BaseTypeGeneric
  5 x base type, all with category=FIXED_LENGTH:
    int8: base-type-size=8, base-type-encoding=2C
    int16: base-type-size=16, base-type-encoding=2C
    int32: base-type-size=32, base-type-encoding=2C
    unsigned_integer: base-type-size=32, base-type-encoding=NONE
    signed_integer: base-type-size=32, base-type-encoding=2C
