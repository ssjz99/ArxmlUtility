AUTOSAR XML (schema 3.2.2)
standard types defined: uint8, uint16, uint32, float32, float64, boolean
package /BaseTypeGeneric
  5 x base type, all with category=FIXED_LENGTH:
    int8: base-type-size=8, base-type-encoding=2C  # 8 bit signed integer
    int16: base-type-size=16, base-type-encoding=2C  # 16 bit signed integer
    int32: base-type-size=32, base-type-encoding=2C  # 32 bit signed integer
    unsigned_integer: base-type-size=32, base-type-encoding=NONE  # 32 bit unsigned integer
    signed_integer: base-type-size=32, base-type-encoding=2C  # 32 bit signed integer
