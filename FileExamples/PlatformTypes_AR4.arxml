AUTOSAR XML (schema 4-2-1)
standard types defined: boolean, float32, float64, sint16, sint32, sint8, uint16, uint32, uint8, boolean_CompuMethod, boolean_DataConstr, float32_DataConstr, float64_DataConstr, sint16_DataConstr, sint32_DataConstr, sint8_DataConstr, uint16_DataConstr, uint32_DataConstr, uint8_DataConstr
